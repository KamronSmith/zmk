## app/boards/shields/twobytwo6/Kconfig.shield
```kconfig
#
# Configuration that defines the shield.
#

config SHIELD_TWOBYTWO6
  def_bool $(shields_list_contains,twobytwo6)

config SHIELD_TWOBYTWO6_LEFT
  def_bool $(shields_list_contains,twobytwo6_left)

config SHIELD_TWOBYTWO6_RIGHT
  def_bool $(shields_list_contains,twobytwo6_right)

#
# End of file.
#
```
